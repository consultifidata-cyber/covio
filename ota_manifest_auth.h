// ============================================================================
// ota_manifest_auth.h — RISK-16 remediation: OTA manifest authenticity
// ----------------------------------------------------------------------------
// Deliberately dependency-free (no Arduino.h, no mbedtls, no ESP-IDF) --
// this is the CANONICAL SERIALIZATION and TIME-VALIDITY logic, extracted so
// it is genuinely host-testable, matching the same pattern already used for
// ota_version_policy.h's evaluateOtaCandidate(). The actual cryptographic
// signature verification (mbedtls_pk_verify) and image-hash computation
// (mbedtls_sha256) are Arduino/ESP-IDF-coupled and live in ota.h, NOT here
// -- see 19_OTA_AUTHENTICITY_DESIGN.md for the explicit scope boundary
// this mirrors.
//
// CANONICAL FORMAT (frozen once published, exactly like SCHEMA_REGISTRY.md's
// own "do not change a published layout" discipline): fields joined by a
// single '\n', in this EXACT order, no trailing newline. This is what gets
// SHA-256'd and ECDSA-signed -- NOT the manifest JSON's raw bytes (JSON
// whitespace/key-ordering is not canonical without a formal canonicalization
// spec, which this project does not implement; a fixed-order delimited
// string sidesteps that ambiguity entirely, per this mandate's own
// instruction not to sign ambiguous JSON formatting without one).
// server/tools/sign_manifest.py builds this EXACT SAME string -- the two
// implementations are independently maintained and must be kept in sync by
// hand; a canonical-string mismatch test (test_ota_manifest_auth.cpp vs. a
// fixture generated by the Python tool) is how phase 2 detects drift.
// ============================================================================
#pragma once
#include <string.h>
#include <stdio.h>

struct SignedManifestFields {
  const char* hwCompat;       // must equal DEVICE_MODEL
  const char* version;        // semantic version string
  long securityVersion;
  long schemaVersion;
  long imageSize;              // bytes
  const char* imageSha256Hex;  // lowercase hex, 64 chars
  const char* imageUrl;
  const char* channel;         // e.g. "stable" -- release-channel identity (RISK-14-adjacent, not enforced by this file, just bound into the signature)
  long issuedAt;                // unix seconds
  long expiresAt;               // unix seconds
  const char* manifestId;      // unique per-release identity
};

// Builds the canonical string into `out` (caller-provided buffer of
// `outCap` bytes). Returns the number of bytes written (excluding the NUL
// terminator), or -1 if outCap was too small -- callers must treat -1 as a
// hard failure (truncated canonical data must NEVER be signed/verified
// against, since that would silently narrow what's actually authenticated).
inline int buildCanonicalManifestString(const SignedManifestFields& f, char* out, size_t outCap) {
  int n = snprintf(out, outCap,
    "%s\n%s\n%ld\n%ld\n%ld\n%s\n%s\n%s\n%ld\n%ld\n%s",
    f.hwCompat, f.version, f.securityVersion, f.schemaVersion, f.imageSize,
    f.imageSha256Hex, f.imageUrl, f.channel, f.issuedAt, f.expiresAt, f.manifestId);
  if (n < 0 || (size_t)n >= outCap) return -1;
  return n;
}

enum ManifestTimeVerdict {
  MANIFEST_TIME_OK,
  MANIFEST_TIME_EXPIRED,
  MANIFEST_TIME_NOT_YET_VALID,   // issuedAt is in the future beyond allowed skew
};

// `nowEstimate`: the device's best estimate of current unix time. This
// codebase has no RTC/NTP (RISK-11, unchanged, pre-existing gap) -- see
// 19_OTA_AUTHENTICITY_DESIGN.md for how ota.h supplies this despite that,
// and its stated limitation. `allowedSkewSeconds`: tolerance for clock
// drift/estimation error in both directions.
inline ManifestTimeVerdict checkManifestTimeValidity(long issuedAt, long expiresAt,
                                                       long nowEstimate, long allowedSkewSeconds) {
  if (nowEstimate > expiresAt + allowedSkewSeconds) return MANIFEST_TIME_EXPIRED;
  if (issuedAt > nowEstimate + allowedSkewSeconds) return MANIFEST_TIME_NOT_YET_VALID;
  return MANIFEST_TIME_OK;
}

inline const char* manifestTimeVerdictStr(ManifestTimeVerdict v) {
  switch (v) {
    case MANIFEST_TIME_OK:            return "ok";
    case MANIFEST_TIME_EXPIRED:       return "expired";
    case MANIFEST_TIME_NOT_YET_VALID: return "not_yet_valid";
    default:                          return "unknown";
  }
}
